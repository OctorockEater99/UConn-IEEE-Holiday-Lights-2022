#include <FastLED.h>
#include <avr/pgmspace.h>               //pgmspace library used to store images in program storage space

#define DATA_PIN 6
#define COLS 14                         //number of leds for x axis in canvas
#define ROWS 16                         //number of leds for y axis in canvas
#define PADDING 4                       //number of leds for padding per row
#define NUM_CANVAS_LEDS ROWS*COLS       //total number of leds in canvas
#define NUM_LEDS ROWS*(COLS + PADDING)  //total number of leds in strips

CRGB leds[NUM_LEDS];

//images are stored in program storage space using PROGMEM keyword
//image dimensions should match with led canvas dimensions COLS and ROWS
//image must be single 1d array of each pixel rgb values
const unsigned char tree[] PROGMEM = { 0, 0, 0, 0, 0, 0, 0, 0, 0, 0, 0, 0, 0,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 0, 0 };
const unsigned char amoung[] PROGMEM = { 0, 0, 0, 0, 0, 0, 0, 0, 0, 0, 0, 0, 0,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 0, 0 };
const unsigned char penguin[] PROGMEM = { 0, 0, 0, 0, 0, 0, 0, 0, 0, 0, 0, 0, 0,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 0, 100 };
const unsigned char u[] PROGMEM = { 0, 0, 0, 153, 217, 234, 153, 217, 234, 153, 217, 234, 153,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 0, 0 };
const unsigned char c[] PROGMEM = { 0, 0, 0, 0, 0, 0, 0, 0, 0, 153, 217, 234, 153,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 0, 0 };
const unsigned char o[] PROGMEM = { 0, 0, 0, 0, 0, 0, 0, 0, 0, 153, 217, 234, 153,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 0, 0 };
const unsigned char n[] PROGMEM = { 0, 0, 0, 153, 217, 234, 153, 217, 234, 153, 217, 234, 153,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 0, 0 };
const unsigned char ieee[] PROGMEM = { 0, 0, 0, 0, 0, 0, 0, 162, 232, 0, 0, 0, 0,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 0, 0 };

/*
Ordering of the LEDs. Keep in mind, the image may or may not be flipped depending on how it is displayed.
Normal serpentine ordering. This can be achieved with cutting the LED string lights to appropriate sizes.
0   ->  1  ->  2  ->  3  ->  4
9   <-  8  <-  7  <-  6  <-  5
10  -> 11  -> 12  -> 13  -> ...

Serpentine ordering with padding. Due to limitation of not being able to cut LED string lights, some rows
will not be balanced correctly leading to undesirable image effects. Use some LEDs as padding to prevent
this distortion. 
X  ->  0  ->  1  ->  2  ->  3  ->  4  ->  X
X  <-  9  <-  8  <-  7  <-  6  <-  5  <-  X
X  -> 10  -> 11  -> 12  -> 13  -> 14  ->  ...
*/

int XY_canvas(int x, int y) {
  /**
   * Maps the correct cartesian coordinate to the LED string canvas. Accounts for padding.
   * 
   * @param x the x coordinate of the image pixel
   * @param y the y coordinate of the image pixel
   * @return i the index of the FastLED array to manipulate
  **/
  int i;
  int j = y * COLS + x;
  int q = (j / COLS) * PADDING;
    
  if (y & 1) {                    // if the y-coordinate (row) is odd,
    int rX = COLS - 1 - x;        // reverse rows, indices correctly reversed
    i = y * COLS + rX + q;
  } else {                        // otherwise, forward rows
    i = j + q;
  }
  return i;
}

int XY(int x, int y) {
  /**
   * Maps the correct cartesian coordinate to an array index.
   * 
   * @param x the x coordinate
   * @param y the y coordinate
   * @return the proper array index
  **/
  return y * COLS + x;
}

void loadImage(struct CRGB* leds_dest, unsigned char* img) { // loads image onto the canvas
  /**
   * Loads input image onto the canvas.
   * 
   * @param leds_dest the canvas destination to map the image onto
   * @param img image list of length 3 * number of pixels
   * @return None
   * 
   * After calling this function, buffers are filled with the appropriate image data.
   * FastLED.show() must be called afterwards to update the LED string.
  **/
  for (int j = 0; j < ROWS; j++) {                                              
    for (int i = 0; i < COLS; i++) {
      leds_dest[XY_canvas(i, j)].r = pgm_read_word_near(img + (3 * XY(i, j)));        // use pgm_read_word_near() from avr/pgmspace 
      leds_dest[XY_canvas(i, j)].g = pgm_read_word_near(img + 1 + (3 * XY(i, j)));    // since that is where the images are stored
      leds_dest[XY_canvas(i, j)].b = pgm_read_word_near(img + 2 + (3 * XY(i, j)));    // images are stored as single array of rgb values
    }
  }
}

void loadColor(struct CRGB* leds_dest, struct CRGB color) {
  /**
   * Loads a color onto the canvas
   * 
   * @param leds_dest the canvas destination to load a color onto
   * @param color the color to fill the canvas with
   * @return None
   * 
   * After calling this function, buffers are filled with the appropriate color data.
   * FastLED.show() must be called afterwards to update the LED string.
  **/
  for (int j = 0; j < ROWS; j++) {
    for (int i = 0; i < COLS; i++) {
      leds_dest[XY_canvas(i, j)] = color;
    }
  }
}

void indexDebug(struct CRGB* leds_dest, struct CRGB color) {
  /**
   * Debug function to check whether the LED string matrix has been properly set up.
   * Iterates through the canvas and turns on single LED in order
   * 
   * @param leds_dest the canvas destination to load a color onto
   * @param color the color to fill the canvas with
   * @return None
  **/
  for (int j = 0; j < ROWS; j++) {
    for (int i = 0; i < COLS; i++) {
      leds_dest[XY_canvas(i, j)] = color;
      FastLED.show();
      delay(50);
    }
  }
  delay(500);
  FastLED.clear();
  FastLED.show();
}

uint8_t rd = random8(0, 5);

void setup() {
  // initialize LED string ojbect and Serial connection
  Serial.begin(9600);
  FastLED.addLeds<WS2812B, DATA_PIN, GRB>(leds, NUM_LEDS);  //.setCorrection(TypicalLEDStrip);
  FastLED.clear();
}

void loop() {
  //holiday tree
  FastLED.clear();
  loadImage(leds, tree);
  FastLED.show();
  delay(20000);

  //ieee
  FastLED.clear();
  loadImage(leds, ieee);
  FastLED.show();
  delay(5000);
  
  //uconn logo
  //u
  FastLED.clear();
  loadImage(leds, u);
  FastLED.show();
  delay(1000);
  FastLED.clear();
  FastLED.show();
  delay(500);
  //c
  FastLED.clear();
  loadImage(leds, c);
  FastLED.show();
  delay(1000);
  FastLED.clear();
  FastLED.show();
  delay(500);
  //o
  FastLED.clear();
  loadImage(leds, o);
  FastLED.show();
  delay(1000);
  FastLED.clear();
  FastLED.show();
  delay(500);
  //n
  for (int k = 0; k < 2; k++) {
    FastLED.clear();
    loadImage(leds, n);
    FastLED.show();
    delay(1000);
    FastLED.clear();
    FastLED.show();
    delay(500);
  }

  //among us :)
  if (rd == 0) {
    FastLED.clear();
    loadImage(leds, amoung);
    FastLED.show();
    delay(5000);
  } else {
    //penguin
    FastLED.clear();
    loadImage(leds, penguin);
    FastLED.show();
    delay(5000);
  }
  rd = random8(0, 5);
}
